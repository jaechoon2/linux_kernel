## Documentation/devicetree/bindings/xylon/adv7511_dts_parameters.txt
```
adv7511@39 {
	compatible = "adv7511";
	reg = <0x39>;
	interrupts = <0 54 4>;
	interrupt-parent = <&gic>;
	dma-request = <&logicvc0>;
	edid-addr = <0x50>;
	video-input {
		input-id = <1>;
		input-style = <3>;
		input-color-depth = <8>;
		bit-justification = <1>;
		hsync-polarity = <0>;
		vsync-polarity = <0>;
		clock-delay = <3>;
	};
	video-output {
		hdmi-mode = <0>;
		output-format = <0>;
		output-color-space = <0>;
		up-conversion = <0>;
		csc-enable = <1>;
		csc-scaling-factor = <2>;
		csc-coefficients {
			a1 = <0x0B37>;
			a2 = <0x0800>;
			a3 = <0x0000>;
			a4 = <0x1A86>;
			b1 = <0x1A49>;
			b2 = <0x0800>;
			b3 = <0x1D3F>;
			b4 = <0x0422>;
			c1 = <0x0000>;
			c2 = <0x0800>;
			c3 = <0x0E2D>;
			c4 = <0x1914>;
		};
	};
};
```

## Documentation/devicetree/bindings/xylon/logii2s_dts_parameters.txt
```
logii2s0: logii2s@40060000 {
	compatible = "xylon,logii2s-2.00.a";
	reg = <0x40060000 0x1000>;
	interrupts = <0 53 4>;
	interrupt-parent = <&gic>;
	instances = <7>;
	system-clock-frequency = <100000000>;
	instance_0 {
		i2s-clock-frequency = <12000000>;
		fifo-size = <2048>;
		almost-full-level = <680>;
		almost-empty-level = <85>;
	};
	instance_1 {
		i2s-clock-frequency = <12000000>;
		fifo-size = <2048>;
		almost-full-level = <680>;
		almost-empty-level = <85>;
	};
	instance_2 {
		i2s-clock-frequency = <12000000>;
		fifo-size = <2048>;
		almost-full-level = <680>;
		almost-empty-level = <85>;
	};
	instance_3 {
		i2s-clock-frequency = <12000000>;
		fifo-size = <2048>;
		almost-full-level = <680>;
		almost-empty-level = <85>;
	};
	instance_4 {
		i2s-clock-frequency = <12000000>;
		fifo-size = <2048>;
		almost-full-level = <680>;
		almost-empty-level = <85>;
	};
	instance_5 {
		i2s-clock-frequency = <12000000>;
		fifo-size = <2048>;
		almost-full-level = <680>;
		almost-empty-level = <85>;
	};
	instance_6 {
		i2s-clock-frequency = <12000000>;
		fifo-size = <2048>;
		almost-full-level = <680>;
		almost-empty-level = <85>;
	};
};
```

## Documentation/devicetree/bindings/xylon/logiwin_dts_parameters.txt
```
logiwin {
	compatible = "xylon,logiwin-3.02.g";
	reg = <0x40010000 0x1000>,
		  <0x40020000 0x1000>,
		  <0x40030000 0x1000>;
	interrupts = <0 58 4>,
				 <0 57 4>,
				 <0 56 4>;
	interrupt-parent = <&gic>;
	logiwin_0 {
		vmem-address = <0x310E0000 0xCA8000>;
		vmem-buffer = <2048 3240>;
		input-num = <1>;
		input-resolution = <1280 720>;
		input-format = <1>;
		output-format = <4>;
		out-byte-align = <1>;
		scale-fraction-bits = <6>;
	};
	logiwin_1 {
		vmem-address = <0x31D88000 0xCA8000>;
		vmem-buffer = <2048 3240>;
		input-num = <1>;
		input-resolution = <1280 720>;
		input-format = <1>;
		output-format = <4>;
		out-byte-align = <1>;
		scale-fraction-bits = <6>;
	};
	logiwin_2 {
		vmem-address = <0x32A30000 0xCA8000>;
		vmem-buffer = <2048 3240>;
		input-num = <1>;
		input-resolution = <1920 1080>;
		input-format = <1>;
		output-format = <4>;
		out-byte-align = <1>;
		scale-fraction-bits = <6>;
	};
};
```

## Documentation/devicetree/bindings/xylon/xylonfb_dts_parameters.txt
```
logicvc0: logicvc@40030000 {
	compatible = "xylon,logicvc-3.00.a";
	reg = <0x40030000 0x6000>;
	interrupts = <0 59 4>;
	interrupt-parent = <&gic>;

	xlnx,display-interface = <0>;
	xlnx,display-color-space = <1>;
	xlnx,ip-license-type = <0>;
	xlnx,ip-major-revision = <3>;
	xlnx,ip-minor-revision = <0>;
	xlnx,ip-patch-level = <0>;
	xlnx,num-of-layers = <3>;
	xlnx,layer-0-type = <0>;
	xlnx,layer-0-alpha-mode = <0>;
	xlnx,layer-0-data-width = <16>;
	xlnx,layer-0-offset = <0>;
	xlnx,layer-1-type = <0>;
	xlnx,layer-1-alpha-mode = <0>;
	xlnx,layer-1-data-width = <24>;
	xlnx,layer-1-offset = <1620>;
	xlnx,layer-2-type = <0>;
	xlnx,layer-2-alpha-mode = <0>;
	xlnx,layer-2-data-width = <24>;
	xlnx,layer-2-offset = <6480>;
	xlnx,layer-3-type = <0>;
	xlnx,layer-3-alpha-mode = <0>;
	xlnx,layer-3-data-width = <24>;
	xlnx,layer-3-offset = <9720>;
	xlnx,layer-4-type = <0>;
	xlnx,layer-4-alpha-mode = <0>;
	xlnx,layer-4-data-width = <24>;
	xlnx,layer-4-offset = <12960>;
	xlnx,buffer-0-offset = <1080>;
	xlnx,buffer-1-offset = <1080>;
	xlnx,buffer-2-offset = <1080>;
	xlnx,buffer-3-offset = <1080>;
	xlnx,buffer-4-offset = <1080>;
	xlnx,little-endian = <1>;
	xlnx,readable-regs = <1>;
	xlnx,row-stride = <2048>;
	xlnx,use-background = <1>;
	xlnx,use-size-position = <1>;
	xlnx,vmem-baseaddr = <0x30000000>;
	xlnx,vmem-highaddr = <0x3FFFFFFF>;

	//Pixel clock source:
	//0-External; 1-ZynqPS; 2-logiCLK; 3-SI570
	pixel-clock-source = <3>;
	pixel-data-invert = <0>;
	pixel-clock-active-high = <0>;
	pixel-component-format = "ARGB";
	pixel-component-layer = <0>,<1>,<2>;
	active-layer = <0>;
	videomode = "1920x1080";
	edid {
		//Set to "1" for configuring logiCVC according to display device EDID
		preffered-videomode = <0>;
		//Set to "1" for displaying EDID in system log
		display-data = <0>;
	};
};

xylon-video-params {
	800x480_TM050RBH01 {
		name = "800x480_TM050RBH01";
		refresh = <60>;
		xres = <800>;
		yres = <480>;
		pixclock-khz = <30000>;
		left-margin = <40>;
		right-margin = <40>;
		upper-margin = <29>;
		lower-margin = <13>;
		hsync-len = <48>;
		vsync-len = <3>;
		sync = <0>;
		vmode = <0>;
	};
	1280x720 {
		name = "1280x720";
		refresh = <60>;
		xres = <1280>;
		yres = <720>;
		pixclock-khz = <74250>;
		left-margin = <220>;
		right-margin = <110>;
		upper-margin = <20>;
		lower-margin = <5>;
		hsync-len = <40>;
		vsync-len = <5>;
		sync = <0>;
		vmode = <0>;
	};
	1680x1050 {
		name = "1680x1050";
		refresh = <60>;
		xres = <1680>;
		yres = <1050>;
		pixclock-khz = <119000>;
		left-margin = <80>;
		right-margin = <48>;
		upper-margin = <21>;
		lower-margin = <3>;
		hsync-len = <32>;
		vsync-len = <6>;
		sync = <0>;
		vmode = <0>;
	};
	1920x1080 {
		name = "1920x1080";
		refresh = <60>;
		xres = <1920>;
		yres = <1080>;
		pixclock-khz = <148500>;
		left-margin = <148>;
		right-margin = <88>;
		upper-margin = <36>;
		lower-margin = <4>;
		hsync-len = <44>;
		vsync-len = <5>;
		sync = <0>;
		vmode = <0>;
	};
};
```

## drivers/media/i2c/Kconfig
```kconfig
config VIDEO_ADV7511
	tristate "Analog Devices ADV7511 HDMI transmitter"
	depends on VIDEO_V4L2 && I2C
	---help---
	  Support for the Analog Devices ADV7511 HDMI transmitter driver

	  To compile this driver as a module, choose M here: the
	  module will be called adv7511.
```

## drivers/media/video/xylon/Kconfig
```kconfig
menuconfig VIDEO_FG_XYLON
	tristate "Xylon frame grabber support"
	depends on VIDEO_V4L2 && V4L_PLATFORM_DRIVERS
	default n
	help
	  Choose this option if you want to use Xylon's frame grabber device.
	  Without the support for PCI.

choice
	prompt "Xylon frame grabber device type"
	depends on VIDEO_FG_XYLON
	default FG_XYLON_LW

config FG_XYLON_LW
	bool "Xylon logiWIN frame grabber"
	depends on VIDEO_FG_XYLON
	help
	  Support for Xylon logiWIN frame grabber.
endchoice
```
